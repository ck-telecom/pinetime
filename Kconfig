## app/drivers/kscan/zephyr/Kconfig
```kconfig
#
# SPDX-License-Identifier: Apache-2.0
#

menuconfig KSCAN_CST816S
	bool "hynitron cst816 touchscreen"
	depends on I2C
	help
	 Enable driver for hynitron touchscreen. 

if KSCAN_CST816S

config KSCAN_CST816S_PEROID
	int "Sample period"
	depends on !KSCAN_FT5336_INTERRUPT
	default 10
	help
	  Sample period in milliseconds when in polling mode.

config KSCAN_CST816S_INTERRUPT
	bool "Enable interrupt"
	help
	  Enable interrupt support (requires GPIO).

endif # KSCAN_CST816S
```

## app/drivers/sensor/Kconfig
```kconfig
# Sensor configuration options

# Copyright (c) 2016 Intel Corporation
# SPDX-License-Identifier: Apache-2.0


# menu "Sensor drivers"


source "bma421/Kconfig"

source "hrs3300/Kconfig"

source "cst816s/Kconfig"

# endmenu
```

## bluetooth/Kconfig
```kconfig
#
# Copyright (c) 2018 Nordic Semiconductor
#
# SPDX-License-Identifier: LicenseRef-Nordic-5-Clause
#

menu "Bluetooth Low Energy"

if BT

rsource "Kconfig.discovery"


rsource "services/Kconfig"
endif # BT

endmenu
```

## drivers/Kconfig
```kconfig
# SPDX-License-Identifier: Apache-2.0

menu "Drivers"
rsource "sensor/Kconfig"
rsource "eeprom/Kconfig"
endmenu
```

## drivers/eeprom/Kconfig
```kconfig
#

# Copyright (c)
# SPDX-License-Identifier: Apache-2.0

config EEPROM_MX25L
	bool "Macronix MX25L SPI EEPROM support"
	depends on SPI
	help
	  Enable driver for Macronix MX25L SPI EEPROM
```

## drivers/sensor/Kconfig
```kconfig
# Sensor configuration options

# Copyright (c) 2016 Intel Corporation
# SPDX-License-Identifier: Apache-2.0


if SENSOR

rsource "bma421/Kconfig"

# rsource "hrs3300/Kconfig"

endif # SENSOR
```

## dts/bindings/sensor/mxicy,cmos-mx25l.yaml
```yaml
# SPDX-License-Identifier: Apache-2.0

description: This is a representation of the spi nor flash

compatible: "mxicy,cmos-mx25l"

include: jedec,spi-nor.yaml
```
