## west.yml
```yaml
# SPDX-License-Identifier: Apache-2.0

manifest:
  defaults:
    remote: zephyrproject-rtos

  remotes:
    - name: zephyrproject-rtos
      url-base: https://github.com/zephyrproject-rtos
    - name: fwatch
      url-base: https://gitee.com/fwatch
    - name: ck-telecom
      url-base: https://github.com/ck-telecom

  projects:
    - name: zephyr
      remote: ck-telcom 
      west-commands: scripts/west-commands.yml
      revision: jdi
      import:
        name-allowlist:
          - cmsis_6
          - hal_nordic
          - hal_sifli

  self:
    path: pinetime
```
